# OPQ_MONOLITHIC_4LANE_MERGE register map
File version: 26.3.6
Ordered priority queue runtime CSR aperture for the MuSiP SWB integration.
Registers are 32-bit, read-write, no defined reset value unless marked. A register's access mark holds for its fields unless they carry their own. Offsets are from the block's base; lines under a group give offsets from that group; [hi:lo] are bit positions; {n}, {i} and the like mark numbered series; 'fields as' and 'values as' point back to an identical list; <NAME> marks a mode.

## Memory map
0x00000000 OPQ size 0x400 — Ordered priority queue CSR window

## OPQ — Ordered priority queue CSR window
Base 0x00000000
0x00 UID — IP identity word
0x04 META — Version/date/git/instance selector window
0x08 LANE_MASK — Runtime lane mask
0x0C CTRL — Control/status selector
0x10 STATUS — Aggregated status
0x14 CAP — Capability word
0x20 FT_WR_HDR — Frame-table written headers
0x24 FT_WR_SHD — Frame-table written subheaders
0x28 FT_WR_HIT — Frame-table written hits
0x2C FT_RD_HDR — Frame-table read headers
0x30 FT_RD_SHD — Frame-table read subheaders
0x34 FT_RD_HIT — Frame-table read hits
0x38 FT_DROP_HDR — Frame-table dropped headers
0x3C FT_DROP_SHD — Frame-table dropped subheaders
0x40 FT_DROP_HIT — Frame-table dropped hits
{0x100+0x40*i} LANE{i}_WR_HDR_CNT (i=0..3) — Per-lane written headers
{0x104+0x40*i} LANE{i}_WR_SHD_CNT (i=0..3) — Per-lane written subheaders
{0x108+0x40*i} LANE{i}_WR_HIT_CNT (i=0..3) — Per-lane written hits
{0x10C+0x40*i} LANE{i}_RD_HDR_CNT (i=0..3) — Per-lane read headers
{0x110+0x40*i} LANE{i}_RD_SHD_CNT (i=0..3) — Per-lane read subheaders
{0x114+0x40*i} LANE{i}_RD_HIT_CNT (i=0..3) — Per-lane read hits
{0x118+0x40*i} LANE{i}_DROP_HDR_CNT (i=0..3) — Per-lane dropped headers
{0x11C+0x40*i} LANE{i}_DROP_SHD_CNT (i=0..3) — Per-lane dropped subheaders
{0x120+0x40*i} LANE{i}_DROP_HIT_CNT (i=0..3) — Per-lane dropped hits
{0x124+0x40*i} LANE{i}_LANE_CREDIT (i=0..3) — Per-lane lane-FIFO credit
{0x128+0x40*i} LANE{i}_TICKET_CREDIT (i=0..3) — Per-lane ticket credit
{0x12C+0x40*i} LANE{i}_DRR_ALLOWANCE (i=0..3) — Configured DRR allowance
{0x130+0x40*i} LANE{i}_DRR_QUANTUM (i=0..3) — Current DRR quantum
{0x134+0x40*i} LANE{i}_DRR_GRANT_CNT (i=0..3) — Grant counter
{0x138+0x40*i} LANE{i}_DRR_BEAT_CNT (i=0..3) — Granted beat counter
{0x13C+0x40*i} LANE{i}_DRR_DEFER_CNT (i=0..3) — Deferred grant counter
